#include "LookUp.h"


//============================================================
// コンストラクタ
//============================================================

LookUp::LookUp(uint8_t id)
{
    // サーボIDを保存
    this->id = id;

    // 初期状態
    state = LookUp_IDLE;

    // 目標位置
    targetPos = 0;

    // 動作開始時刻
    startTime = 0;
}


//============================================================
// 初期化
//============================================================

void LookUp::begin()
{
    //========================================================
    // STS3046用シリアル
    //========================================================
    //
    // Mega側のsetup()などで、
    //
    // Serial1.begin(1000000);
    //
    // を先に実行しておく。
    //
    // ここではSerial1をSTS3046の通信先として設定する。
    //========================================================

    servo.pSerial = &Serial1;
}


//============================================================
// 手動操作
// 上方向へ1段階進める
//============================================================

void LookUp::up()
{
    //========================================================
    // 現在位置を取得
    //========================================================

    int currentPos = servo.ReadPos(id);


    //========================================================
    // 通信失敗
    //========================================================

    if (currentPos == -1)
    {
        return;
    }


    //========================================================
    // 目標位置を計算
    //========================================================
    //
    // 【調整項目】
    //
    // LookUp_STEP の値を変更することで、
    // up() 1回あたりの移動量を変更できる。
    //
    // 例：
    //
    // STEP = 20
    //
    // 現在位置 2000
    //      ↓
    // 目標位置 2020
    //========================================================

    targetPos = currentPos + LookUp_STEP;


    //========================================================
    // ソフトウェア上限
    //========================================================

    if (targetPos > MAX_POS)
    {
        targetPos = MAX_POS;
    }


    //========================================================
    // サーボへ移動指令
    //========================================================

    servo.WritePosEx(
        id,
        targetPos,
        LookUp_SPEED,
        ACC
    );


    //========================================================
    // 状態を移動中へ変更
    //========================================================

    startTime = millis();

    state = LookUp_MOVING;
}


//============================================================
// 手動操作
// 下方向へ1段階戻す
//============================================================

void LookUp::down()
{
    //========================================================
    // 現在位置を取得
    //========================================================

    int currentPos = servo.ReadPos(id);


    //========================================================
    // 通信失敗
    //========================================================

    if (currentPos == -1)
    {
        return;
    }


    //========================================================
    // 目標位置を計算
    //========================================================
    //
    // LookUp_STEP の値を変更することで、
    // down() 1回あたりの移動量を変更できる。
    //========================================================

    targetPos = currentPos - LookUp_STEP;


    //========================================================
    // ソフトウェア下限
    //========================================================

    if (targetPos < MIN_POS)
    {
        targetPos = MIN_POS;
    }


    //========================================================
    // サーボへ移動指令
    //========================================================

    servo.WritePosEx(
        id,
        targetPos,
        LookUp_SPEED,
        ACC
    );


    //========================================================
    // 状態を移動中へ変更
    //========================================================

    startTime = millis();

    state = LookUp_MOVING;
}


//============================================================
// 状態更新
//============================================================

void LookUp::update()
{
    //========================================================
    // 停止中なら何もしない
    //========================================================

    if (state == LookUp_IDLE)
    {
        return;
    }


    //========================================================
    // 現在位置を取得
    //========================================================

    int currentPos = servo.ReadPos(id);


    //========================================================
    // 通信失敗
    //========================================================
    //
    // 現在位置を取得できなかった場合、
    // 安全側として動作中状態を解除する。
    //========================================================

    if (currentPos == -1)
    {
        state = LookUp_IDLE;

        return;
    }


    //========================================================
    // 目標位置へ到達したか
    //========================================================
    //
    // POSITION_TOLERANCE以内なら、
    // 目標位置へ到達したと判断する。
    //========================================================

    if (abs(currentPos - targetPos)
        <= POSITION_TOLERANCE)
    {
        state = LookUp_IDLE;

        return;
    }


    //========================================================
    // タイムアウト
    //========================================================
    //
    // 一定時間経過しても目標位置に到達しない場合、
    // 動作を終了する。
    //
    // 【調整項目】
    //
    // LookUp_TIMEOUT を実機の移動時間に合わせて調整する。
    //
    // 例：
    // 実際の移動時間が300msなら、
    // 500～700ms程度から試す。
    //========================================================

    if (millis() - startTime >= LookUp_TIMEOUT)
    {
        state = LookUp_IDLE;

        return;
    }
}


//============================================================
// 動作中か
//============================================================

bool LookUp::isMoving()
{
    return state != LookUp_IDLE;
}


//============================================================
// 上側の位置にいるか
//============================================================

bool LookUp::isPosition()
{
    //========================================================
    // 現在位置を取得
    //========================================================

    int currentPos = servo.ReadPos(id);


    //========================================================
    // 通信失敗
    //========================================================
    //
    // 現在位置が取得できない場合は、
    // 上側にいるとは判断しない。
    //========================================================

    if (currentPos == -1)
    {
        return false;
    }


    //========================================================
    // 上側位置との距離を確認
    //========================================================
    //
    // POSITION_POSを基準として、
    // POSITION_TOLERANCE以内なら
    // 「上側の位置にいる」と判断する。
    //
    // 例：
    //
    // POSITION_POS = 3000
    // TOLERANCE   = 20
    //
    // 2980～3020
    //      ↓
    // true
    //
    // 【調整方法】
    //
    // 実機を目的の上側位置まで動かし、
    //
    // int currentPos = servo.ReadPos(id);
    //
    // で値を確認する。
    //
    // 例えばReadPos()が3150なら、
    //
    // POSITION_POS = 3150
    //
    // とする。
    //========================================================

    return
        abs(currentPos - POSITION_POS)
        <= POSITION_TOLERANCE;
}