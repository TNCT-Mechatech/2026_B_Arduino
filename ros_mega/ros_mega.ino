//============================================================
// mega.ino
// 26robocon-B
// 補充・装填・回収機構
// 2026-08-26
// kanayama syunya
//
// Raspberry Pi → Arduino Mega
// A / B / X ボタンを受信
//
// Arduino Mega → Raspberry Pi
// A / B / X ボタンを返信
//
// LED
// A7 : Mega起動確認
// A6 : Raspberry Piからの通信受信確認
//============================================================

#include <Arduino.h>

#include "Reload.h"
#include "Collect.h"

#include <math.h>

#include <SerialBridge.hpp>
#include <InoHardwareSerial.hpp>


//============================================================
// Raspberry Pi → Mega
//============================================================

typedef struct
{
    uint8_t buttonB;
    uint8_t buttonA;
    uint8_t buttonX;

} MEGA_t;


//============================================================
// Mega → Raspberry Pi
//============================================================

typedef struct
{
    uint8_t buttonB;
    uint8_t buttonA;
    uint8_t buttonX;

} MEGA_Response_t;


//============================================================
// SerialBridge
//============================================================

sb::Message<MEGA_t> joy_msg;

sb::Message<MEGA_Response_t> response_msg;

InoHardwareSerial serial(&Serial);

SerialBridge bridge(&serial);


//============================================================
// LED
//============================================================

// Mega起動確認LED
const uint8_t LED_STARTUP = A7;

// Raspberry Piからの通信確認LED
const uint8_t LED_RX = A6;


//============================================================
// 通信LED点灯時間
//============================================================

const unsigned long LED_RX_TIME = 50;

unsigned long led_rx_on_time = 0;


//============================================================
// ピン配置
//============================================================

//============================================================
// 装填機構のカム
//============================================================

Motor motor_6(5, 4); //pin配置修正した0905


//============================================================
// カム上昇限界
//============================================================

const uint8_t limit_9 = A0; //  ピン配置修正した0905


//============================================================
// Reload
//============================================================

Reload arm(
    12,      // motor_1 PWM
    13,      // motor_1 DIR
    14,     // limit open LS_1
    15      // limit close LS_2
);


//============================================================
// Collect
//============================================================

Collect rack(
    9,      // motor_3 PWM  回収下
    8,      // motor_3 DIR

    11,      // motor_4 PWM
    10,      // motor_4 DIR

    7,      // motor_5 PWM
    6,      // motor_5 DIR

    16,     // limit_3
    17,     // limit_4
    20,     // limit_5
    21,     // limit_6
    A2,     // limit_7
    A1      // limit_8
);


//============================================================
// 補充機構の状態
//============================================================

enum ChargeState
{
    Charge_RELOAD_Can,
    Charge_RELOAD_Moving,
    Charge_RELOAD_UP
};

ChargeState chargeState = Charge_RELOAD_Can;


//============================================================
// カム上昇時のフラグ
//============================================================

bool sw_reload_flg = false;


//============================================================
// コントローラー入力
//============================================================

uint8_t buttonA = 0;
uint8_t buttonB = 0;
uint8_t buttonX = 0;


//============================================================
// setup
//============================================================

void setup()
{
    //========================================================
    // LED初期化
    //========================================================

    pinMode(LED_STARTUP, OUTPUT);
    pinMode(LED_RX, OUTPUT);

    digitalWrite(LED_STARTUP, LOW);
    digitalWrite(LED_RX, LOW);


    //========================================================
    // Raspberry Piとのシリアル通信
    //========================================================

    Serial.begin(115200);


    //========================================================
    // SerialBridge
    //========================================================

    // Pi → Mega
    bridge.add_frame(
        0,
        &joy_msg
    );


    // Mega → Pi
    bridge.add_frame(
        1,
        &response_msg
    );


    //========================================================
    // 初期値
    //========================================================

    joy_msg.data.buttonA = 0;
    joy_msg.data.buttonB = 0;
    joy_msg.data.buttonX = 0;

    response_msg.data.buttonA = 0;
    response_msg.data.buttonB = 0;
    response_msg.data.buttonX = 0;


    //========================================================
    // Reload初期化
    //========================================================

    arm.begin();


    //========================================================
    // Collect初期化
    //========================================================

    rack.begin();


    //========================================================
    // 装填カム初期化
    //========================================================

    motor_6.begin();


    //========================================================
    // リミットスイッチ
    //========================================================

    pinMode(
        limit_9,
        INPUT_PULLUP
    );


    //========================================================
    // モーター停止
    //========================================================

    motor_6.stop();


    //========================================================
    // Mega起動確認
    // A7 LED
    //========================================================

    digitalWrite(LED_STARTUP, HIGH);

    delay(200);

    digitalWrite(LED_STARTUP, LOW);
}


//============================================================
// loop
//============================================================

void loop()
{
    //========================================================
    // Raspberry Piから受信
    //========================================================

    bridge.update();


    //========================================================
    // 新しいデータを受信した場合
    //========================================================

    if (joy_msg.was_updated())
    {
        //======================================================
        // Raspberry Piから通信を受信したことを表示
        // A6 LED
        //======================================================

        digitalWrite(LED_RX, HIGH);

        led_rx_on_time = millis();


        //======================================================
        // A / B / X を取得
        //======================================================

        buttonA = joy_msg.data.buttonA;
        buttonB = joy_msg.data.buttonB;
        buttonX = joy_msg.data.buttonX;


        //======================================================
        // Piへ受信したデータを返信
        //======================================================

        response_msg.data.buttonA = buttonA;
        response_msg.data.buttonB = buttonB;
        response_msg.data.buttonX = buttonX;

        bridge.write(1);
    }


    //========================================================
    // A6通信LED OFF
    //========================================================

    if (
        digitalRead(LED_RX) == HIGH &&
        millis() - led_rx_on_time >= LED_RX_TIME
    )
    {
        digitalWrite(LED_RX, LOW);
    }


    //========================================================
    // 補充中
    //========================================================

    if (chargeState == Charge_RELOAD_Moving)
    {
        arm.update();


        if (arm.isMoving() == false)
        {
            chargeState = Charge_RELOAD_Can;
        }
    }


    //========================================================
    // 補充可能
    //========================================================

    else if (chargeState == Charge_RELOAD_Can)
    {
        //====================================================
        // コントローラーA → 補充
        //====================================================

        if (buttonA == 1)
        {
            arm.start();

            chargeState = Charge_RELOAD_Moving;
        }


        //====================================================
        // コントローラーB → 装填
        //====================================================

        else if (buttonB == 1)
        {
            chargeState = Charge_RELOAD_UP;

            motor_6.drive(100);
        }
    }


    //========================================================
    // カム上昇中
    //========================================================

    else if (chargeState == Charge_RELOAD_UP)
    {
        //====================================================
        // Aボタン
        // または
        // リロードスイッチフラグ
        //====================================================

        if (
            buttonA == 1 ||
            sw_reload_flg == true
        )
        {
            sw_reload_flg = true;


            //================================================
            // リミットに到達していない
            //================================================

            if (digitalRead(limit_9) == HIGH)
            {
                motor_6.drive(100);
            }


            //================================================
            // リミットに到達
            //================================================

            else
            {
                motor_6.stop();

                sw_reload_flg = false;

                chargeState = Charge_RELOAD_Can;
            }
        }


        //====================================================
        // 入力なし
        //====================================================

        else
        {
            motor_6.drive(100);
        }
    }


    //========================================================
    // コントローラーX → 回収機構
    //========================================================

    rack.setControllerCollect(
        buttonX == 1
    );

    rack.update();
}